#include "master_mb.h"
// #include "mbtable.h"

#define UART1RX_PIN         5
#define UART1TX_PIN         17

// mbtable tb1(125);
// mbtable tb2(125);
// mbtable tb3(125);
// mbtable tb4(125);
// mbtable tb5(125);
// mbtable tb6(125);
// mbtable tb7(125);

const uint8_t CRC_HI[] = { 0x00, 0xC1, 0x81, 0x40, 0x01, 0xC0, 0x80, 0x41, 0x01, 0xC0, 0x80, 0x41, 0x00,
  0xC1, 0x81, 0x40, 0x01, 0xC0, 0x80, 0x41, 0x00, 0xC1, 0x81, 0x40, 0x00,
  0xC1, 0x81, 0x40, 0x01, 0xC0, 0x80, 0x41, 0x01, 0xC0, 0x80, 0x41, 0x00,
  0xC1, 0x81, 0x40, 0x00, 0xC1, 0x81, 0x40, 0x01, 0xC0, 0x80, 0x41, 0x00,
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  0xC1, 0x81, 0x40 };

const uint8_t CRC_LO[] = { 0x00, 0xC0, 0xC1, 0x01, 0xC3, 0x03, 0x02, 0xC2, 0xC6, 0x06, 0x07, 0xC7, 0x05,
  0xC5, 0xC4, 0x04, 0xCC, 0x0C, 0x0D, 0xCD, 0x0F, 0xCF, 0xCE, 0x0E, 0x0A,
  0xCA, 0xCB, 0x0B, 0xC9, 0x09, 0x08, 0xC8, 0xD8, 0x18, 0x19, 0xD9, 0x1B,
  0xDB, 0xDA, 0x1A, 0x1E, 0xDE, 0xDF, 0x1F, 0xDD, 0x1D, 0x1C, 0xDC, 0x14,
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  0x81, 0x80, 0x40 };


master_mb::master_mb(HardwareSerial *ptSerial,uint32_t inv,uint32_t timeout,uint32_t between_poles,uint32_t scan_t)
{
  _interval=inv;
  _time_out=timeout;
  _between_poles_t=between_poles;
  _scan_t=scan_t;
  serialPtr=ptSerial;
  // ConfigSerial(d8bits,stopbits1,parity_none,bps115200);
  seq_cmd=0;
}

master_mb::~master_mb()
{

}

uint16_t master_mb::CAL_CRC16(type_crc *crcptr, uint8_t *dptr, uint8_t n) {
	uint8_t i, j;
	crcptr->H = crcptr->L = 0xFF;
	for (i = 0; i < n; i++, dptr++) {
		j = crcptr->H ^ *dptr;
		crcptr->H = crcptr->L ^ CRC_HI[j];
		crcptr->L = CRC_LO[j];
	}
  return(crcptr->word);
}

void master_mb::set_serial(HardwareSerial *ptSerial)
{
  serialPtr=ptSerial;
}

void master_mb::set_interval(unsigned long inv)
{
    _interval=inv;
}

void master_mb::set_timeout(unsigned long timeout)
{
  _time_out=timeout;
}

void master_mb::set_between_poles(unsigned long poles_t)
{
  _between_poles_t=poles_t;
}

void master_mb::set_scan_time(unsigned long scan_t)
{
  _scan_t=scan_t;
}

void master_mb::set_read_command(uint8_t *mbtable,uint16_t cmd,uint16_t id,uint16_t str_req,uint16_t reg_req)
{
  type_crc mb_crc;
  switch (cmd)
  {
  case 3:
  case 4:
    mbtable[0]=id;
    mbtable[1]=cmd;
    mbtable[2]=(str_req>>8)&0x00FF;
    mbtable[3]=(str_req&0x00FF);
    mbtable[4]=(reg_req>>8)&0x00FF;
    mbtable[5]=(reg_req&0x00FF);
    mb_crc.word=CAL_CRC16(&mb_crc,mbtable,6);
    break;
  case 6:
    break;
  case 16:
    break;
  default:
    break;
  }
}

void master_mb::handelTask()
{
    unsigned long currentMills=millis();
    if(currentMills-_lastmillis >= _interval)
    {
        _lastmillis = currentMills;
        loopcnt++;
        serialPtr->println("handel task"+String(loopcnt));
    }
}

void master_mb::run_ex()
{
    if(ready==0)
        {       return;        }
    
}


/*=====================================================================================================
**
** CONFIGURATION SERIAL
**
=====================================================================================================*/
// void master_mb::ConfigSerial(byte datasize, byte stopbit, byte parity,byte baudrate)
// {
//   uint32_t serconfig = SERIAL_8N1;
//   int serbaudrate = 9600;
  
//   if(datasize == 0) {
//     if(stopbit == 1) {
//       switch(parity) {
//         case 0 : serconfig = SERIAL_7N1;
//           break; 
//         case 1 : serconfig = SERIAL_7E1;
//           break; 
//         case 2 : serconfig = SERIAL_7O1;
//           break; 
//       }
//     }else if(stopbit == 2) {
//       switch(parity) {
//         case 0 : serconfig = SERIAL_7N2;
//           break; 
//         case 1 : serconfig = SERIAL_7E2;
//           break; 
//         case 2 : serconfig = SERIAL_7O2;
//           break; 
//       }
//     }
//   }else if(datasize == 1) {
//     if(stopbit == 1) {
//       switch(parity) {
//         case 0 : serconfig = SERIAL_8N1;
//           break; 
//         case 1 : serconfig = SERIAL_8O1;
//           break; 
//         case 2 : serconfig = SERIAL_8E1;
//           break; 
//       }
//     }else if(stopbit == 2) {
//       switch(parity) {
//         case 0 : serconfig = SERIAL_8N2;
//           break; 
//         case 1 : serconfig = SERIAL_8O2;
//           break; 
//         case 2 : serconfig = SERIAL_8E2;
//           break; 
//       }
//     }
//   }

//   switch(baudrate) {
//     case 0 : serbaudrate = 2400; 
//         break; 
//     case 1 : serbaudrate = 4800; 
//       break; 
//     case 2 : serbaudrate = 9600; 
//       break; 
//     case 3 : serbaudrate = 19200; 
//       break; 
//     case 4 : serbaudrate = 38400; 
//       break; 
//     case 5 : serbaudrate = 57600; 
//       break; 
//     case 6 : serbaudrate = 115200; 
//       break; 
//     default :serbaudrate = 9600;
//   }
//   serialPtr->begin(serbaudrate, serconfig,UART1RX_PIN,UART1TX_PIN);
//   // Serial1.begin(serbaudrate, serconfig,UART1RX_PIN,UART1TX_PIN);
//   //Serial1.begin(serbaudrate, serconfig,
// }